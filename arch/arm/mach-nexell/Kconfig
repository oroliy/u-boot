## arch/arm/mach-nexell/Kconfig
```kconfig
if ARCH_NEXELL

config ARCH_S5P4418
	bool "Nexell S5P4418 SoC"
	select CPU_V7A
	select OF_CONTROL
	select NX_GPIO
	select DM_SERIAL
	select PL01X_SERIAL
	help
	  Enable support for Nexell S5P4418 SoC.

config ARCH_S5P6818
	bool "Nexell S5P6818 SoC"
	select OF_CONTROL
	select NX_GPIO
	select DM_SERIAL
	help
	  Enable common support for the Nexell S5P6818 SoC. Board targets
	  select either the AArch32 or AArch64 execution state.

menu "Nexell S5P4418/S5P6818"
	depends on ARCH_NEXELL

choice
	prompt "Nexell S5P4418/S5P6818 board select"
	optional

config TARGET_NANOPI2
	bool "FriendlyARM NanoPi2 / NanoPC-T2 Board"
	select ARCH_S5P4418
	help
	  Enable support for FriendlyARM NanoPi2 and NanoPC-T2 Boards.

config TARGET_X6818
	bool "Nexell S5P6818 x6818 board"
	select ARCH_S5P6818
	select CPU_V7A
	help
	  Enable support for the Nexell S5P6818 x6818 board (AArch32).

config TARGET_X6818_ARM64
	bool "Nexell S5P6818 x6818 board (AArch64 BL33)"
	select ARCH_S5P6818
	select ARM64
	select ARM_SMCCC
	select SYSRESET
	select SYSRESET_NEXELL_PSCI
	help
	  Enable the AArch64 x6818 BL33 target entered by TF-A at EL2. This
	  target uses the Nexell SoC timer and PSCI firmware interfaces. The
	  S5P6818 does not provide a running counter to the architectural timer.

endchoice

config SYS_PLLFIN
	int

config TIMER_SYS_TICK_CH
	int

config SYS_BOARD
	default "nanopi2" if TARGET_NANOPI2
	default "x6818" if TARGET_X6818
	default "x6818" if TARGET_X6818_ARM64

config SYS_VENDOR
	default "friendlyarm"

config SYS_SOC
	default "nexell"

config SYS_CONFIG_NAME
	default "s5p4418_nanopi2" if TARGET_NANOPI2
	default "x6818" if TARGET_X6818
	default "x6818" if TARGET_X6818_ARM64

config SYS_PLLFIN
	default 24000000

config TIMER_SYS_TICK_CH
	default 0

endmenu

source "board/friendlyarm/Kconfig"

endif
```

## board/friendlyarm/x6818/Kconfig
```kconfig
if TARGET_X6818 || TARGET_X6818_ARM64

config SYS_BOARD
	default "x6818"

config SYS_VENDOR
	default "friendlyarm"

config SYS_CONFIG_NAME
	default "x6818"

endif
```

## configs/x6818_arm64_defconfig
```kconfig
CONFIG_ARM=y
CONFIG_COUNTER_FREQUENCY=12000000
# CONFIG_SYS_ARCH_TIMER is not set
CONFIG_POSITION_INDEPENDENT=y
CONFIG_ARCH_NEXELL=y
CONFIG_TEXT_BASE=0x43C00000
CONFIG_SYS_MALLOC_LEN=0x2000000
CONFIG_NR_DRAM_BANKS=1
CONFIG_ENV_SIZE=0x8000
CONFIG_DM_GPIO=y
CONFIG_DEFAULT_DEVICE_TREE="s5p6818-x6818-arm64"
CONFIG_SYS_LOAD_ADDR=0x48000000
CONFIG_DEBUG_UART_BASE=0xC00A1000
CONFIG_DEBUG_UART_CLOCK=50000000
CONFIG_ARMV8_SET_SMPEN=y
CONFIG_TARGET_X6818_ARM64=y
CONFIG_ROOT_DEV=2
CONFIG_BOOT_PART=1
CONFIG_ROOT_PART=2
CONFIG_DEBUG_UART=y
CONFIG_SYS_MEMTEST_START=0x50000000
CONFIG_SYS_MEMTEST_END=0x7E000000
CONFIG_FIT=y
CONFIG_FIT_BEST_MATCH=y
CONFIG_SUPPORT_RAW_INITRD=y
CONFIG_BOOTDELAY=1
CONFIG_SYS_PBSIZE=1050
# CONFIG_DISPLAY_CPUINFO is not set
CONFIG_BOARD_LATE_INIT=y
CONFIG_HUSH_PARSER=y
CONFIG_SYS_PROMPT="x6818-arm64# "
# CONFIG_CMD_SAVEENV is not set
CONFIG_CMD_MEMTEST=y
CONFIG_CMD_GPIO=y
CONFIG_CMD_I2C=y
CONFIG_CMD_MMC=y
CONFIG_CMD_PART=y
CONFIG_CMD_USB=y
CONFIG_CMD_DHCP=y
CONFIG_CMD_MII=y
CONFIG_CMD_PING=y
CONFIG_CMD_BMP=y
CONFIG_CMD_EXT4=y
CONFIG_CMD_EXT4_WRITE=y
CONFIG_CMD_FAT=y
CONFIG_CMD_FS_GENERIC=y
CONFIG_ENV_OVERWRITE=y
CONFIG_DM_I2C=y
CONFIG_SYS_I2C_NEXELL=y
CONFIG_MMC_DW=y
CONFIG_ETH_DESIGNWARE=y
CONFIG_ETH_DESIGNWARE_NEXELL=y
CONFIG_PHY_ADDR=4
CONFIG_PINCTRL=y
CONFIG_DEBUG_UART_SKIP_INIT=y
CONFIG_SYSRESET=y
CONFIG_USB=y
CONFIG_USB_EHCI_HCD=y
CONFIG_USB_EHCI_NEXELL=y
CONFIG_USB_OHCI_HCD=y
CONFIG_USB_OHCI_NEXELL=y
CONFIG_USB_STORAGE=y
CONFIG_VIDEO=y
CONFIG_DISPLAY=y
CONFIG_VIDEO_NX=y
CONFIG_VIDEO_NX_RGB=y
CONFIG_VIDEO_NX_LVDS=y
CONFIG_VIDEO_NX_MIPI=y
CONFIG_VIDEO_NX_HDMI=y
CONFIG_SPLASH_SCREEN=y
CONFIG_SPLASH_SCREEN_ALIGN=y
CONFIG_BMP_24BPP=y
CONFIG_BMP_32BPP=y
CONFIG_ERRNO_STR=y
# CONFIG_TOOLS_MKEFICAPSULE is not set
```

## configs/x6818_defconfig
```kconfig
CONFIG_ARM=y
CONFIG_SYS_DCACHE_OFF=y
CONFIG_ARCH_CPU_INIT=y
CONFIG_ARCH_NEXELL=y
CONFIG_ARCH_S5P6818=y
# CONFIG_DISPLAY_CPUINFO is not set
CONFIG_TEXT_BASE=0x43C00000
CONFIG_SYS_MALLOC_LEN=0x2000000
CONFIG_SYS_MALLOC_F_LEN=0x400
CONFIG_NR_DRAM_BANKS=2
CONFIG_HAS_CUSTOM_SYS_INIT_SP_ADDR=y
CONFIG_CUSTOM_SYS_INIT_SP_ADDR=0x43c00000
CONFIG_ENV_SIZE=0x8000
CONFIG_ENV_OFFSET=0x900000
CONFIG_DM_GPIO=y
CONFIG_DEFAULT_DEVICE_TREE="s5p6818-x6818"
CONFIG_SYS_LOAD_ADDR=0x48000000
CONFIG_DEBUG_UART_BASE=0xC00A1000
CONFIG_DEBUG_UART_CLOCK=50000000
CONFIG_TARGET_X6818=y
CONFIG_ROOT_DEV=2
CONFIG_BOOT_PART=1
CONFIG_ROOT_PART=2
CONFIG_DEBUG_UART=y
CONFIG_SYS_MEMTEST_START=0x50000000
CONFIG_SYS_MEMTEST_END=0x80000000
CONFIG_FIT=y
CONFIG_FIT_BEST_MATCH=y
CONFIG_SUPPORT_RAW_INITRD=y
CONFIG_BOOTDELAY=1
CONFIG_SYS_PBSIZE=1050
CONFIG_BOARD_LATE_INIT=y
CONFIG_HUSH_PARSER=y
CONFIG_SYS_PROMPT="x6818# "
CONFIG_CMD_BOOTZ=y
CONFIG_CMD_MEMTEST=y
CONFIG_CMD_GPIO=y
CONFIG_CMD_MMC=y
CONFIG_CMD_MII=y
CONFIG_CMD_I2C=y
CONFIG_CMD_PART=y
CONFIG_CMD_EXT4=y
CONFIG_CMD_EXT4_WRITE=y
CONFIG_CMD_FS_GENERIC=y
CONFIG_CMD_FAT=y
CONFIG_CMD_NET=y
CONFIG_CMD_DHCP=y
CONFIG_CMD_PING=y
CONFIG_CMD_TFTPBOOT=y
CONFIG_CMD_BMP=y
CONFIG_ENV_OVERWRITE=y
CONFIG_ENV_IS_IN_MMC=y
CONFIG_ENV_MMC_DEVICE_INDEX=2
CONFIG_MMC_DW=y
CONFIG_DM_I2C=y
CONFIG_SYS_I2C_NEXELL=y
CONFIG_PINCTRL=y
CONFIG_ETH_DESIGNWARE=y
CONFIG_ETH_DESIGNWARE_NEXELL=y
CONFIG_PHY_ADDR_ENABLE=y
CONFIG_PHY_ADDR=4
CONFIG_PHY_GIGE=y
CONFIG_PHY_REALTEK=y
CONFIG_VIDEO=y
CONFIG_DISPLAY=y
CONFIG_VIDEO_NX=y
CONFIG_VIDEO_NX_MIPI=y
CONFIG_PWM_S5P=y
CONFIG_VIDEO_NX_RGB=y
CONFIG_VIDEO_NX_LVDS=y
CONFIG_VIDEO_NX_HDMI=y
CONFIG_SPLASH_SCREEN=y
CONFIG_SPLASH_SCREEN_ALIGN=y
CONFIG_BMP=y
CONFIG_BMP_24BPP=y
CONFIG_BMP_32BPP=y
CONFIG_DEBUG_UART_S5P6818=y
CONFIG_DEBUG_UART_SKIP_INIT=y
CONFIG_ERRNO_STR=y
# CONFIG_TOOLS_MKEFICAPSULE is not set
```
